/*
 * Copyright (c) 2020 The ZMK Contributors
 * Copyright (c) 2022 Innaworks Development Limited, trading as MoErgo
 *
 * SPDX-License-Identifier: MIT
 */

#include <behaviors.dtsi>

/* Include all behaviour includes needed by system behaviors/macros */
/* Include behaviour includes needed by key binds - automatically generated */

#include <dt-bindings/zmk/bt.h>
#include <dt-bindings/zmk/keys.h>
#include <dt-bindings/zmk/outputs.h>
#include <dt-bindings/zmk/rgb.h>
#include <dt-bindings/zmk/pointing.h>

#include "zmk-nodefree-config/include/zmk-helpers/helper.h"
#include "zmk-nodefree-config/include/zmk-helpers/key-labels/glove80.h"

#include "behaviors.h"
#include "combos.h"
#include "layer_names.h"
#include "macros.h"

/* Defines */
#define ___ &trans
#define XXX &none

&lt {
    tapping-term-ms = <140>;
};

&caps_word {
    continue-list = <UNDERSCORE BACKSPACE DELETE MINUS>; // Adding minus to the default continue list
};

/ {
    macros {
        rgb_ug_status_macro: rgb_ug_status_macro_0 {
            label = "RGB_UG_STATUS";
            compatible = "zmk,behavior-macro";
            #binding-cells = <0>;
            bindings = <&rgb_ug RGB_STATUS>;
        };
    };
};

// BASE
ZMK_LAYER(base,
  &kp F1            &kp F2          &kp F3        &kp F4         &kp F5                                                                                                                                                         &kp F6         &kp F7         &kp F8        &kp F9           &kp F10
  &kp EQUAL         &lpar_lt        &kp LBKT      &kp RBKT       &rpar_gt      &kp COLON                                                                                                                                XXX     XXX            &kp EQUAL      &kp MINUS     XXX              &kp MINUS
  &kp TAB           &kp Q           &kp W         &kp F          &kp P         &kp G                                                                                                                                    &kp M   &kp L          &kp U          &kp Y         &kp SEMI         &kp BSLH
  &kp ESC           &hml LGUI A     &hml LALT R   &hml LCTRL S   &hml LSHFT T  &kp V                                                                                                                                    &kp K   &hmr RSHFT N   &hmr RCTRL E   &hmr LALT I   &hmr RGUI O      &kp SQT
  &lpt LOWER GRAVE  &lpt MOUSE Z    &lpt NUM X    &kp C          &kp D         &kp B   &thumb FN BSPC       &tdnum                        &lower                   &kp RGUI  &kp LG(LC(LALT))   &kp RET                 &kp J   &kp H          &kp COMMA      &kp DOT       &rpt PROG FSLH   &pshft
  &magic 2 0        &kp N0          &kp RA(W)     &kp RA(A)      &kp RA(O)             &thumb CURSOR SPACE  &thumbdel LG(LC(LALT)) DEL    &kp LS(LG(LC(LALT)))     &kp TAB   &shiftdance        &thumb SYMBOLS SPACE            &kp LEFT       &kp DOWN       &kp UP        &kp RIGHT        &kp PG_DN
)


// LOWER
ZMK_LAYER(lower,
  &kp C_BRI_DN  &kp C_BRI_UP  &kp C_PREV      &kp C_NEXT      &kp C_PP                                                                                                                      &kp C_MUTE  &kp C_VOL_DN  &kp C_VOL_UP  XXX               &kp PAUSE_BREAK
  ___           XXX           XXX             XXX             XXX              &kp HOME                                                                                        &kp LPAR     XXX         &kp EQUAL     &kp SLASH     &kp KP_MULTIPLY   &kp PRINTSCREEN
  ___           XXX           XXX             &kp UP_ARROW    XXX              &kp END                                                                                         &kp RPAR     &kp N7      &kp N8        &kp N9        &kp MINUS         XXX
  ___           XXX           &kp LEFT_ARROW  &kp DOWN_ARROW  &kp RIGHT_ARROW  &kp PG_UP                                                                                       &kp PERCENT  &kp N4      &kp N5        &kp N6        &kp PLUS          XXX
  ___           &kp K_APP     XXX             &kp F11         &kp F12          &kp PG_DN  &to MOUSE      &to NUM    &to BASE                    ___     ___     ___            &kp COMMA    &kp N1      &kp N2        &kp N3        &kp ENTER         &kp LS(TAB)
  &magic 2 0    &kp CAPS      &kp INS         &kp F11         &kp F12                     &to CURSOR     &to GAME   ___                         ___     ___     &to SYMBOLS                 &kp N0      &kp COMMA     &kp DOT       &kp ENTER         &kp TAB
)

// MAGIC
ZMK_LAYER(magic,
  &bt BT_CLR       XXX              XXX              XXX              XXX                                                                                                        XXX    XXX    XXX    XXX    &bt BT_CLR_ALL
  XXX              XXX              XXX              XXX              XXX              XXX                                                                                XXX    XXX    XXX    XXX    XXX    XXX  
  XXX              &rgb_ug RGB_SPI  &rgb_ug RGB_SAI  &rgb_ug RGB_HUI  &rgb_ug RGB_BRI  &rgb_ug RGB_TOG                                                                    XXX    XXX    XXX    XXX    XXX    XXX  
  &bootloader      &rgb_ug RGB_SPD  &rgb_ug RGB_SAD  &rgb_ug RGB_HUD  &rgb_ug RGB_BRD  &rgb_ug RGB_EFF                                                                    XXX    XXX    XXX    XXX    XXX    &bootloader
  &sys_reset       XXX              XXX              XXX              XXX              XXX              &bt_2  &bt_3  XXX                       XXX    XXX         XXX    XXX    XXX    XXX    XXX    XXX    &sys_reset
  XXX              XXX              XXX              XXX              XXX                               &bt_0  &bt_1  &out OUT_USB              XXX    &caps_word  XXX           XXX    XXX    XXX    XXX    XXX  
)

// NUM
ZMK_LAYER(numpad,
  ___    ___          ___          ___           ___                                                                                                         &kp C_MUTE  &kp C_VOL_DN  &kp C_VOL_UP  XXX              &kp PAUSE_BREAK
  ___    ___          ___          ___           ___               ___                                                                           &kp LPAR    XXX         &kp KP_EQUAL  &kp FSLH      &kp KP_MULTIPLY  &kp PRINTSCREEN
  ___    ___          ___          &kp SPACE     &kp LS(TAB)       ___                                                                           &kp G       &kp N7      &kp N8        &kp N9        &kp KP_MINUS     XXX
  ___    &hml LGUI A  &hml LALT R  &hml LCTRL S  &hml LSHFT BSPC   &kp DEL                                                                       &kp K       &kp N4      &kp N5        &kp N6        &kp KP_PLUS      XXX
  ___    ___          ___          ___           &kp TAB           ___       ___     ___     ___               ___          ___      &kp RET     &kp J       &kp N1      &kp N2        &kp N3        &kp KP_ENTER     &kp LC(A)
  ___    ___          ___          ___           ___                         ___     ___     &to BASE          &kp COMMA    &kp DOT  &kp N0                  &kp LBKT    &lpar_lt      &rpar_gt      &kp RBKT         &kp LC(X)
)

// FN
ZMK_LAYER(fn,
  ___     ___     ___     ___     ___                                                                                      ___       ___       ___      ___      ___   
  ___     ___     ___     ___     ___     ___                                                                  ___         ___       ___       ___      ___      ___   
  ___     ___     ___     ___     ___     ___                                                                  &kp LPAR    &kp F7    &kp F8    &kp F9   &kp F10  ___   
  ___     ___     ___     ___     ___     ___                                                                  &kp RPAR    &kp F4    &kp F5    &kp F6   &kp F11  ___   
  ___     ___     ___     ___     ___     ___     ___     ___     ___                  ___     ___     ___     &kp COLON   &kp F1    &kp F2    &kp F3   &kp F12  ___   
  ___     ___     ___     ___     ___             ___     ___     ___                  ___     ___     ___                 ___       ___       ___      ___      ___   
)

// GAME
ZMK_LAYER(game,
  &kp F1     &kp F2      &kp F3   &kp F4  &kp F5                                                                                                        &kp F6  &kp F7  &kp F8      &kp F9    &kp F10  
  &kp EQUAL  &kp N1      &kp N2   &kp N3  &kp N4  &kp N5                                                                                        &kp N6  &kp N7  &kp N8  &kp N9      &kp N0    &kp BSLH
  &kp P      &kp I       &kp B    &kp N   &kp M   &kp SQT                                                                                       &kp B   &kp N   &kp M   &kp COMMA   &kp DOT   &kp FSLH
  &kp T      &kp TAB     &kp Q    &kp W   &kp E   &kp R                                                                                         &kp T   &kp Y   &kp U   &kp I       &kp O     &kp P
  &kp G      &kp LSHFT   &kp A    &kp S   &kp D   &kp F   &kp ESC     &kp ENTER    ___                       &kp BSPC   &kp DEL     ___         &kp G   &kp H   &kp J   &kp K       &kp L     &kp P
  &kp V      &kp LCTRL   &kp Z    &kp X   &kp C           &kp SPACE   &kp LALT     &to BASE                  &to BASE   &kp TAB     &kp SPACE           &kp Y   &kp U   &kp I       &kp O     &kp P
)

// PROG
ZMK_LAYER(prog,
  ___     ___         ___        ___        ___                                                                                         ___     ___     ___     ___     ___   
  ___     ___         ___        ___        ___         ___                                                                     ___     ___     ___     ___     ___     ___   
  ___     ___         &kp LT     &kp GT     &kp COLON   ___                                                                     ___     ___     ___     ___     ___     ___   
  ___     &kp LBRC    &kp LPAR   &kp RPAR   &kp RBRC    ___                                                                     ___     ___     ___     ___     ___     ___   
  ___     &kp COMMA   &kp LT     &kp GT     &kp STAR    ___     ___     ___     ___                     ___     ___     ___     ___     ___     ___     ___     ___     ___   
  ___     ___         ___        ___        ___                 ___     ___     ___                     ___     ___     ___             ___     ___     ___     ___     ___   
)


// CURSOR
ZMK_LAYER(cursor,
  ___     ___             ___             ___           ___                                                                                                                        ___            ___            ___         ___              ___   
  ___     ___             ___             ___           &kp DEL       &kp INS                                                                                             ___      &kp DEL        ___            ___         ___              ___   
  ___     ___             &redo           &undo         &kp BSPC      &cut                                                                                                &cut     &kp BSPC       &undo          &redo       &kp TAB          ___   
  ___     &kp LGUI        &kp LALT        &kp LCTRL     &kp LSHFT     &copy                                                                                               &copy    &kp LEFT       &kp DOWN       &kp UP      &kp RIGHT        &kp RSHFT   
  ___     &kp LG(A)       &select_word    &select_line  &kp LG(F)     &paste    ___     ___     ___                        &select_none   &extend_line   &extend_word     &paste   &kp LG(LEFT)   &kp LA(DOWN)   &kp LA(UP)  &kp LG(RIGHT)    ___   
  ___     &kp LS(LG(G))   &extend_word    &extend_line  &kp LG(G)               ___     ___     &to BASE                   &to BASE       &select_line   &select_word              ___            ___            ___         ___              ___   
)

// SYMBOLS
ZMK_LAYER(sym,
  ___                ___              ___               ___                ___                                                                                                                            ___         ___           ___         ___           ___   
  ___                &kp GRAVE        &kp SQT           &kp DQT            &kp COMMA          &kp SEMI                                                                                      &kp SEMI      ___         ___           ___         ___           ___   
  &kp EXCLAMATION    &kp LBRC         &kp LPAR          &kp RPAR           &kp RBRC           &kp QMARK                                                                                     &kp COMMA     &kp RSHFT   &kp RCTRL     &kp RALT    &kp RGUI      ___   
  &kp HASH           &kp CARET        &kp EQUAL         &kp UNDERSCORE     &kp DOLLAR         &kp STAR                                                                                      &kp DOT       &kp BSPC    &kp TAB       &kp SPACE   &kp ENTER     ___   
  &kp TILDE          &kp LESS_THAN    &kp PIPE          &kp MINUS          &kp GREATER_THAN   &kp FSLH     &kp BSLH      &kp DOT     &kp STAR                  ___          ___     ___     &kp FSLH      &kp DEL     &kp LS(TAB)   ___         ___           ___   
  &kp AT             &kp AMPERSAND    &kp LBKT          &kp RBKT           &kp PLUS                        &kp PERCENT   &kp COLON   &to BASE                  &to BASE     ___     ___                   ___         ___           ___         ___           ___   
)

// MOUSE LAYER 
ZMK_LAYER(mouse,
  ___   ___   ___   ___   ___                                                                                             ___             ___             ___              ___              ___   
  ___   ___   ___   ___   ___             ___                                                                       ___   ___             ___             ___              ___              ___   
  ___   ___   ___   ___   ___             ___                                                                       ___   ___             ___             ___              ___              ___
  ___   ___   ___   ___   &mo MOUSE_FAST  ___                                                                       ___   &mmv MOVE_LEFT  &mmv MOVE_DOWN  &mmv MOVE_UP     &mmv MOVE_RIGHT  ___
  ___   ___   ___   ___   ___             ___   &to BASE        ___   ___           ___       ___        &mkp MB3   ___   &msc SCRL_LEFT  &msc SCRL_DOWN  &msc SCRL_UP     &msc SCRL_RIGHT  ___  
  ___   ___   ___   ___   ___                   ___             ___   &to BASE      &to BASE  &mkp MB2   &mkp MB1         ___             ___             ___              ___              ___   
)

// FAST MOUSE LAYER 
ZMK_LAYER(mouse_fast,
  ___   ___   ___   ___   ___                                                                         ___             ___             ___           ___              ___   
  ___   ___   ___   ___   ___   ___                                                             ___   ___             ___             ___           ___              ___   
  ___   ___   ___   ___   ___   ___                                                             ___   ___             ___             ___           ___              ___   
  ___   ___   ___   ___   ___   ___                                                             ___   ___             ___             ___           ___              ___   
  ___   ___   ___   ___   ___   ___   ___   ___   ___           ___       ___        ___        ___   ___             ___             ___           ___              ___   
  ___   ___   ___   ___   ___         ___   ___   ___           ___       ___        ___              ___             ___             ___           ___              ___   
)


#include <input/processors.dtsi>

// MOUSE_SCALER_FAST sets parameters for the &zip_xy_scaler input processor:
// https://zmk.dev/docs/keymaps/input-processors/scaler
#define MOUSE_SCALER_FAST 3 1

// Scaling for mouse movement, based on @caksoylar's example:
// https://github.com/caksoylar/zmk-config/commit/0020c23c544cd7111013f0114609d1fb90e0e475
//
&mmv_input_listener {
  fast {
    layers = <MOUSE_FAST>;
    input-processors = <&zip_xy_scaler MOUSE_SCALER_FAST>;
  };
};

/ {
  input_processors {
    zss: zip_scroll_scaler {
      compatible = "zmk,input-processor-scaler";
      #input-processor-cells = <2>;
      type = <INPUT_EV_REL>;
      codes = <INPUT_REL_WHEEL INPUT_REL_HWHEEL>;
      track-remainders;
    };
  };
};

&msc_input_listener {
  fast {
    layers = <MOUSE_FAST>;
    input-processors = <&zss MOUSE_SCALER_FAST>;
  };
};


